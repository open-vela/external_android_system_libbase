## Kconfig
```kconfig
#
# Copyright (C) 2023 Xiaomi Corporation
#
# Licensed under the Apache License, Version 2.0 (the "License");
# you may not use this file except in compliance with the License.
# You may obtain a copy of the License at
#
#      http://www.apache.org/licenses/LICENSE-2.0
#
# Unless required by applicable law or agreed to in writing, software
# distributed under the License is distributed on an "AS IS" BASIS,
# WITHOUT WARRANTIES OR CONDITIONS OF ANY KIND, either express or implied.
# See the License for the specific language governing permissions and
# limitations under the License.
#

config ANDROID_LIBBASE
	bool
	depends on LIBCXX && KVDB

if ANDROID_LIBBASE

config ANDROID_LIBBASE_TEST
	bool "Enable the test for libbase"
	default n
	depends on GOOGLE_TEST

if ANDROID_LIBBASE_TEST

config ANDROID_LIBBASE_TEST_PRIORITY
	int "Android libbase test priority"
	default 100

config ANDROID_LIBBASE_TEST_STACKSIZE
	int "Android libbase test stack size"
	default DEFAULT_TASK_STACKSIZE

endif #ANDROID_LIBBASE_TEST
endif #ANDROID_LIBBASE
```
